## boards/orange/pi5_plus/board.yml
```yaml
board:
  name: pi5_plus
  full_name: Orange Pi 5 Plus
  vendor: Orange Pi
  socs:
  - name: rk3588
    variants:
    - name: smp
```

## boards/orange/pi5_plus/pi5_plus_defconfig
```kconfig
# Copyright 2024 Université Gustave Eiffel
# SPDX-License-Identifier: Apache-2.0

# Platform Configuration
CONFIG_ARM64_VA_BITS_40=y
CONFIG_ARM64_PA_BITS_40=y
CONFIG_SYS_CLOCK_HW_CYCLES_PER_SEC=24000000
CONFIG_CACHE_MANAGEMENT=y
CONFIG_ARMV8_A_NS=y

# Serial Drivers
CONFIG_SERIAL=y
CONFIG_UART_INTERRUPT_DRIVEN=y

# Enable Console
CONFIG_CONSOLE=y
CONFIG_UART_CONSOLE=y
CONFIG_UART_6=y

CONFIG_GPIO=y

# Networking
CONFIG_NETWORKING=y
CONFIG_NET_IPV4=y
CONFIG_NET_DHCPV4=y
CONFIG_ETHERNET=y
CONFIG_ETH_RK3588_DWMAC=y
CONFIG_NET_BUF_RX_COUNT=64
CONFIG_NET_BUF_TX_COUNT=64
CONFIG_NET_BUF_DATA_SIZE=1536
CONFIG_NET_TCP=n
CONFIG_INIT_STACKS=y
CONFIG_LOG=y
```

## boards/orange/pi5_plus/pi5_plus_smp_defconfig
```kconfig
# Copyright 2022 HNU-ESNL
# Copyright 2022 openEuler SIG-Zephyr
# SPDX-License-Identifier: Apache-2.0

# Platform Configuration
CONFIG_ARM64_VA_BITS_40=y
CONFIG_ARM64_PA_BITS_40=y
CONFIG_SYS_CLOCK_HW_CYCLES_PER_SEC=24000000
CONFIG_CACHE_MANAGEMENT=y
CONFIG_ARMV8_A_NS=y

# Serial Drivers
CONFIG_SERIAL=y
CONFIG_UART_INTERRUPT_DRIVEN=y

# Enable Console
CONFIG_CONSOLE=y
CONFIG_UART_CONSOLE=y

# SMP support
CONFIG_SMP=y
CONFIG_MP_MAX_NUM_CPUS=8
CONFIG_MAX_THREAD_BYTES=4

# PSCI support
CONFIG_PM_CPU_OPS=y
CONFIG_PM_CPU_OPS_PSCI=y

# Device Tree
CONFIG_UART_NS16550=y

#####################
#### RK Drivers  ####
#####################

CONFIG_PINCTRL=y
CONFIG_PINCTRL_ROCKCHIP_RK3588=y

# Abilita supporto GPIO
CONFIG_GPIO=y

# Abilita driver RK3588
CONFIG_GPIO_ROCKCHIP=y

# Abilita clock control
CONFIG_CLOCK_CONTROL=y
CONFIG_CLOCK_CONTROL_ROCKCHIP=y

# Logging generale
CONFIG_LOG=y
CONFIG_LOG_DEFAULT_LEVEL=4
CONFIG_LOG_OVERRIDE_LEVEL=4
CONFIG_LOG_MODE_IMMEDIATE=y
CONFIG_LOG_BACKEND_UART=n
CONFIG_GPIO_LOG_LEVEL_DBG=y

# Assert e messaggi fatali più verbosi
CONFIG_ASSERT=y
```

## drivers/clock_control/Kconfig.rockchip
```kconfig
config CLOCK_CONTROL_ROCKCHIP
	bool "Rockchip Clock Control driver"
	depends on DT_HAS_ROCKCHIP_RK3588_CRU_ENABLED
	help
	  Abilita il driver di clock control per Rockchip RK3588.
	  Questo driver gestisce l’abilitazione/disabilitazione e
	  interrogazione della frequenza dei clock periferici
	  tramite il CRU (Clock and Reset Unit).
```

## drivers/ethernet/Kconfig.rk3588
```kconfig
config ETH_RK3588_DWMAC
	bool "Rockchip RK3588 DWMAC glue"
	depends on ETHERNET
	depends on DT_HAS_SNPS_DESIGNWARE_ETHERNET_ENABLED
	depends on SOC_RK3588
	select ETH_DWMAC
	help
	  Enable the glue driver that bridges the Rockchip RK3588 GMAC to the
	  generic Synopsys DesignWare MAC core. The driver takes care of the
	  clock/reset/pinctrl plumbing, MDIO access and link management.

config ETH_RK3588_RGMII_DELAY_DEFAULT
	int "Default RK3588 RGMII internal delay (ps)"
	default 1800
	depends on ETH_RK3588_DWMAC
	help
	  Default internal delay applied on RK3588 when device tree does not
	  specify rockchip,tx-delay-ps / rockchip,rx-delay-ps. Value is in
	  picoseconds.
```

## drivers/gpio/Kconfig.rk3588
```kconfig
if GPIO
config GPIO_ROCKCHIP
    bool "Rockchip GPIO driver"
    default y
    depends on SOC_FAMILY_ROCKCHIP
endif
```

## drivers/gpio/Kconfig.rockchip
```kconfig
menu "Rockchip GPIO drivers"

config GPIO_ROCKCHIP
	bool "GPIO for Rockchip RK3588"
	depends on GPIO
	depends on DT_HAS_ROCKCHIP_RK3588_GPIO_ENABLED
	default y
	help
	  Driver GPIO per i bank Rockchip stile RK3588 (32 pin/bank).

endmenu
```

## drivers/pinctrl/Kconfig.rk3588
```kconfig
menu "Rockchip RK3588 pinctrl"

config PINCTRL_ROCKCHIP_RK3588
    bool "RK3588 pinctrl (BUS_IOC, mux only)"
    depends on PINCTRL
    depends on DT_HAS_ROCKCHIP_RK3588_PINCTRL_ENABLED
    help
      Driver pinctrl basilare per RK3588 (BUS_IOC, banche GPIO1..GPIO4).
      Supporta la selezione funzione (IOMUX). PMU_IOC/GPIO0, pull/drive TBD.

endmenu
```

## drivers/pinctrl/Kconfig.rockchip
```kconfig
menu "Rockchip pinctrl drivers"
config PINCTRL_ROCKCHIP
  bool "Pinctrl for RK3588"
  depends on PINCTRL
  depends on DT_HAS_ROCKCHIP_RK3588_PINCTRL_ENABLED
  default y
endmenu
```

## drivers/serial/Kconfig.dw
```kconfig
config UART_DW
    bool "DesignWare UART driver"
    depends on SERIAL && SOC_RK3588
    select SERIAL_HAS_DRIVER
    select SERIAL_SUPPORT_INTERRUPT
    help
      Enable support for DesignWare APB UART (snps,dw-apb-uart) for RK3588.
```

## dts/bindings/clock/rockchip,rk3588-cru.yaml
```yaml
# SPDX-License-Identifier: (GPL-2.0-or-later OR MIT)

description: Rockchip RK3588 Clock and Reset Unit

compatible: "rockchip,rk3588-cru"

include: [clock-controller.yaml, reset-controller.yaml, base.yaml]

properties:
  "#clock-cells":
    type: int
    const: 1
  "#reset-cells":
    type: int
    const: 1

clock-cells:
  - id

reset-cells:
  - id
```

## dts/bindings/ethernet/rockchip,rk3588-dwmac.yaml
```yaml
# SPDX-License-Identifier: (GPL-2.0-or-later OR MIT)

title: Rockchip RK3588 DWMAC Ethernet Controller

description: |
  Glue layer for the RK3588 GMAC instances built on top of the Synopsys
  DesignWare MAC (QoS) IP. This binding augments the generic DWMAC binding
  with Rockchip specific clock/reset and delay properties.

compatible: "rockchip,rk3588-dwmac"

include:
  - name: snps,designware-ethernet.yaml
  - name: pinctrl-device.yaml

properties:
  clocks:
    type: phandle-array
    required: true
    description: Clocks feeding the controller (usually aclk, pclk, tx, rx).

  clock-names:
    type: string-array
    required: true

  resets:
    type: phandle-array
    description: Reset line controlling the DWMAC core.

  reset-names:
    type: string-array

  rockchip,tx-delay-ps:
    type: int
    description: Optional RGMII TX clock delay in picoseconds.
    default: 1800

  rockchip,rx-delay-ps:
    type: int
    description: Optional RGMII RX clock delay in picoseconds.
    default: 1800

  phy-addr:
    type: int
    description: MDIO address of the external PHY.
    required: true
```

## dts/bindings/gpio/rockchip,rk3588-gpio.yaml
```yaml
# SPDX-License-Identifier: Apache-2.0
title: Rockchip RK3588 GPIO Bank

description: >
  GPIO controller for RK3588 (DW APB GPIO-like, single-port A).

compatible: "rockchip,rk3588-gpio"

include: [gpio-controller.yaml, base.yaml]

properties:
  reg:
    required: true
  interrupts:
    required: false
  clocks:
    type: phandle-array
    required: false
  clock-names:
    type: string-array
    required: false
  resets:
    type: phandle-array
    required: false
  reset-names:
    type: string-array
    required: false
  rockchip,bank-index:
    type: int
    required: true
    description: Bank index (0..4)
  label:
    required: false

gpio-cells:
  - pin
  - flags
```

## dts/bindings/misc/zephyr,pinctrl-consumer.yaml
```yaml
# SPDX-License-Identifier: Apache-2.0
title: Generic pinctrl consumer for application use

description: >
  Dummy device so that application code can use PINCTRL_DT_DEFINE /
  pinctrl_apply_state() con un nodo "fittizio".

compatible: "zephyr,pinctrl-consumer"

include: base.yaml

properties:
  pinctrl-0:
    type: phandles
    required: false
  pinctrl-names:
    type: string-array
    required: false
```

## dts/bindings/pinctrl/rockchip,rk3588-pinctrl.yaml
```yaml
# SPDX-License-Identifier: Apache-2.0
title: Rockchip RK3588 BUS_IOC pinctrl

description: >
  Controller pinctrl RK3588, blocco BUS_IOC (GPIO1..GPIO4).
  Supporta IOMUX (funzione). Pull/drive non ancora gestiti qui.

compatible: "rockchip,rk3588-pinctrl"

include: [base.yaml]

properties:
  reg:
    required: true

  clocks:
    type: phandle-array
    required: true
    description: Phandle to the CRU clock controller providing BUS_IOC pclk

  clock-names:
    type: string-array
    required: true
    enum:
      - pclk_bus_ioc
    description: Must contain "pclk_bus_ioc"

  resets:
    type: phandle-array
    required: true
    description: Phandle and specifier for the BUS_IOC reset (from CRU)

  reset-names:
    type: string-array
    required: true
    enum:
      - rst_p_bus_ioc
    description: Must contain "rst_p_bus_ioc"

child-binding:
  description: Pinctrl state (lista di pinmux)
  properties:
    pinmux:
      type: array
      required: true
      description: >
        Lista di u32 ciascuno codificato con RK3588_PINMUX(bank, port, pin, func).
```

## dts/bindings/serial/snps,dw-apb-uart.yaml
```yaml
# Copyright (c) 2017 Linaro Limited
# SPDX-License-Identifier: Apache-2.0

description: Synopsys DesignWare APB UART controller

compatible: "snps,dw-apb-uart"

include: uart-controller.yaml

properties:
  reg:
    required: true
    description: Base address and length of the UART registers.
  interrupts:
    required: true
    description: Interrupt line for the UART controller.
  clocks:
    type: phandle-array
    required: true
    description:
      List of phandles and clock specifiers for the UART clocks.
      Typically, this will include a baud clock and an APB clock.
  clock-names:
    type: string-array
    required: true
    description:
      Names corresponding to the clocks property (e.g., "baudclk", "apb_pclk").


  clock-frequency:
    type: int
    required: true
    description: Input clock frequency for the baud rate generator in Hz.
  reg-shift:
    type: int
    required: false
    default: 0
    description: Register access shift.
  reg-io-width:
    type: int
    required: false
    default: 4
    description: Register access width in bytes.
  pinctrl-0:
    type: phandle
    required: false
    description: Pin control configuration for default state.
  pinctrl-names:
    type: string-array
    required: false
    description: Pin control state names.
```

## soc/rockchip/rk35/rk3588/Kconfig
```kconfig
config SOC_RK3588
	select ARM64
	select CPU_CORTEX_A55
	select ARM_ARCH_TIMER

config SOC_PART_NUMBER
	default "RK3588" if SOC_RK3588
```

## soc/rockchip/rk35/rk3588/Kconfig.defconfig.rk3588
```kconfig
if SOC_RK3588

config NUM_IRQS
	default 544 #TODO: Verificare

config FLASH_SIZE
	default 0

config FLASH_BASE_ADDRESS
	default 0

endif
```

## soc/rockchip/rk35/rk3588/Kconfig.soc
```kconfig
config SOC_RK3588
	bool
	select SOC_SERIES_RK35

config SOC
	default "rk3588" if SOC_RK3588
```
